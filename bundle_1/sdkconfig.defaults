## bundle_1/sdkconfig.defaults
```kconfig
CONFIG_COMPILER_CXX_EXCEPTIONS=y
CONFIG_ESP_MAIN_TASK_STACK_SIZE=16384
CONFIG_ESP_TASK_WDT_EN=n
CONFIG_ESPTOOLPY_FLASHSIZE_16MB=y
CONFIG_IDF_TARGET="esp32s3"
CONFIG_LIBC_NEWLIB=y
CONFIG_PARTITION_TABLE_CUSTOM=y
```
